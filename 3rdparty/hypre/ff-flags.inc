abs_top_builddir = @abs_top_builddir@
CXX = @CXX@
MPICXX = @MPICXX@
ac_ct_CXX = @ac_ct_CXX@
CC = @CC@
MPICC = @MPICC@
YACC = @YACC@
ac_ct_CC = @ac_ct_CC@
FLIBS = @FLIBS@
CXXFLAGS = @CXXFLAGS@
CFLAGS = @CFLAGS@
FCFLAGS = @FCFLAGS@
FFMETIS_CFLAGS = @FFMETIS_CFLAGS@
X_CFLAGS = @X_CFLAGS@
CFLAGSF77 = @CFLAGSF77@
F77 = @F77@
MPIF77 = @MPIF77@
ac_ct_F77 = @ac_ct_F77@
FFLAGS = @FFLAGS@
LDFLAGS = @LDFLAGS@
STD_LDFLAGS = @STD_LDFLAGS@
FLIBS = @FLIBS@
WGET = @WGET@
WIN32DLLTARGET = @WIN32DLLTARGET@
FFMPIDIRLIBS = @MPI_LIB_DIRS@
FFMPIDIR = @MPI_INC_DIR@
FFMPILIB2 = @MPI_LIB@
BLASLIBS = @BLASLIBS@
LAPACKLIBS = @LAPACKLIBS@
